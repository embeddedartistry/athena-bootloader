#include <string.h>
#include <avr/pgmspace.h>

void setup()
{
	DDRD = B11111111;  // Set Port D as Output
	DDRC = B111111;
	pinMode(10,OUTPUT);
	pinMode(11,OUTPUT);
	pinMode(8,OUTPUT);  // Set Clock for the shift register
	digitalWrite(8,LOW);  // The D flip-flops of the shift register respond to the rising edge
	set_shiftregister();  // Give initial state to the shift register (B10000000)
	init_output();
}

const unsigned char char_tab[128][8] PROGMEM = {
	{0, 0, 0, 0, 0, 0, 0, 0},                 // null    (0)
	{0, 0, 0, 0, 0, 0, 0, 0},                 // Strtfhea(1)
	{0, 0, 0, 0, 0, 0, 0, 0},                 // Strtftex(2)
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	{0, 0, 0, 0, 0, 0, 0, 0},                 // untsepar(31)
	// Printable Characters
	{0, 0, 0, 0, 0, 0, 0, 0},                 // Space   (32)
	{16, 16, 16, 16, 16, 16, 0, 16},          // !       (33)
	{108, 108, 72, 0, 0, 0, 0, 0},            // "       (34)
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	{0, 0, 0, 50, 76, 0, 0, 0},               // ~       (126)
	// Non-printable character
	{0, 0, 0, 0, 0, 0, 0, 0}                  // DEL     (127)
};


unsigned long time = millis();
const int scrolling_speed = 100;  // Time to scroll in msec
uint8_t i_th = 0;  // i-th character of the message
char message[] = "Hello FOSSCOMM! P-SPACE, BITCHES!!    ";  // Message to print
uint8_t output[8][3];  // Output mapping
uint8_t s_count = 0;  // # of scrolls for a character


void loop()
{
	uint8_t carry;

	if(millis() - time > 120) {
		time = millis();

		if(s_count == 7) {
			for(uint8_t i=0; i<8; i++)
				output[i][2] = pgm_read_byte(&char_tab[message[i_th]][i]);
			i_th = ++i_th % strlen(message);
			s_count = 0;
		}

		for(uint8_t j=0; j<8; j++) {
			output[j][1] <<= 1;
			carry = SREG & 1;
			output[j][0] = (output[j][0] << 1) + carry;
			output[j][2] <<= 1;
			carry = SREG & 1;
			output[j][1] += carry;
		}

		s_count++;
	}

	for(uint8_t line_i=0; line_i<8; line_i++) {
		PORTD = output[line_i][0];  // Output the line_i-th line of the character
		PORTC = output[line_i][1];
		digitalWrite(10,(output[line_i][1]&64)&&64);
		digitalWrite(11,(output[line_i][1]&128)&&128);
		pulse_clock();
	}  // Move to the next row
}

void set_shiftregister()
{
	// Send a pulse to influence the Set and Reset inputs of the D flip-flops
	// Set bits of shift register (B10000000)
	// Set/Reset inputs respond to the on-state (1)
	pinMode(9,OUTPUT);
	digitalWrite(9,LOW);
	delay(1);
	digitalWrite(9,HIGH);
	delay(20);
	digitalWrite(9,LOW);
}

void init_output()
{
	// Initialize memory to output
	for(uint8_t i=0; i<8; i++) {
		output[i][0] = 0;
		output[i][1] = 0;
		output[i][2] = pgm_read_byte(&char_tab[message[i_th]][i]);
	}
	i_th++;
}

void pulse_clock()
{
	// Send a pulse to the Clock input of the shift register
	// Register response to the rising edge
	digitalWrite(8,HIGH);
	delay(1);
	digitalWrite(8,LOW);
}
